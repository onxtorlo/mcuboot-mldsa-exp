## CMakeLists.txt
```
# SPDX-License-Identifier: Apache-2.0

cmake_minimum_required(VERSION 3.20.0)

find_package(Zephyr REQUIRED HINTS $ENV{ZEPHYR_BASE})
project(hello)

# Tag printed at boot to tell images apart (e.g. -DAPP_TAG=v2)
if(NOT DEFINED APP_TAG)
  set(APP_TAG v1)
endif()
target_compile_definitions(app PRIVATE APP_TAG="${APP_TAG}")

target_sources(app PRIVATE src/main.c)
```

## prj.conf
```kconfig
# Built to run from slot0 behind MCUboot; signed separately with imgtool
CONFIG_BOOTLOADER_MCUBOOT=y
```

## drop_partitions.overlay
```dts
/* ChkUp compatibility PoC: drop the board's own flash layout so boot_conf/<board>.overlay applies */
&flash0 {
	/delete-node/ partitions;
};
```

## slot0.overlay
```dts
/* Run the application from slot0 (partitions come from boot_conf/) */
/ {
	chosen {
		zephyr,code-partition = &slot0_partition;
	};
};
```

## src/main.c
```c
/*
 * SPDX-License-Identifier: Apache-2.0
 */

#include <stdio.h>

int main(void)
{
	printf("[%s] Hello World! %s\n", APP_TAG, CONFIG_BOARD_TARGET);

	return 0;
}
```
